## meta-rcar-xen/conf/layer.conf
```bitbake
# We have a conf and classes directory, add to BBPATH
BBPATH =. "${LAYERDIR}:"

# We have recipes-* directories, add to BBFILES
BBFILES += "${LAYERDIR}/recipes-*/*/*.bb \
            ${LAYERDIR}/recipes-*/*/*.bbappend"

BBFILE_COLLECTIONS += "meta-rcar-xen"
BBFILE_PATTERN_meta-rcar-xen = "^${LAYERDIR}/"
BBFILE_PRIORITY_meta-rcar-xen = "6"

LAYERSERIES_COMPAT_meta-rcar-xen = "dunfell"
```
